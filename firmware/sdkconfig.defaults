## firmware/sdkconfig.defaults
```kconfig
# BLE
CONFIG_BT_ENABLED=y
CONFIG_BT_BLE_ENABLED=y
CONFIG_BT_BLUEDROID_ENABLED=y
CONFIG_BT_BLE_SMP_ENABLE=y
CONFIG_BT_BLE_42_FEATURES_SUPPORTED=y
CONFIG_BTDM_CTRL_MODE_BLE_ONLY=y
CONFIG_BT_BLE_BLUEDROID_BLE_ONLY=y

# BLE bonding
CONFIG_BT_BLE_MAX_BONDS=4

# NVS
CONFIG_NVS_ENABLED=y

# USB CDC (managed component esp_tinyusb)
CONFIG_TINYUSB_CDC_ENABLED=y
CONFIG_TINYUSB_CDC_COUNT=1

# Route console to UART0 (so idf.py monitor works via COM port)
CONFIG_ESP_CONSOLE_USB_SERIAL_JTAG=n
CONFIG_ESP_CONSOLE_UART_DEFAULT=y

# FreeRTOS stack sizes for BLE
CONFIG_BT_BTU_TASK_STACK_SIZE=4096
CONFIG_BT_BTC_TASK_STACK_SIZE=4096

# Partition table
CONFIG_PARTITION_TABLE_SINGLE_APP=y
```
